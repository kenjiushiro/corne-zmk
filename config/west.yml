## config/west.yml
```yaml
manifest:
  remotes:
    - name: ftc
      url-base: https://github.com/ftc
  projects:
    - name: ftc
      remote: ftc
      revision: mouse-ftc
      import: app/west.yml
  self:
    path: config
```
